## conf/layer.conf
```bitbake
# We have a conf and classes directory, append to BBPATH
BBPATH .= ":${LAYERDIR}"

BBFILES += "${LAYERDIR}/recipes*/*/*.bb ${LAYERDIR}/recipes*/*/*.bbappend ${LAYERDIR}/images/*.bb"

BBFILE_COLLECTIONS += "meta-wandboard-qt"
BBFILE_PATTERN_meta-wandboard-qt := "^${LAYERDIR}/"
BBFILE_PRIORITY_meta-wandboard-qt = "16"

LAYERSERIES_COMPAT_meta-wandboard-qt = "dunfell"
```
